## config/west.yml
```yaml
manifest:
  remotes:
    # zmk official
    - name: zmkfirmware
      url-base: https://github.com/zmkfirmware
      # bravekarma
    # - name: caksoylar
    #   url-base: https://github.com/caksoylar
    - name: duckyb
      url-base: https://github.com/duckyb
    - name: urob
      url-base: https://github.com/urob
      # nice-view-gem
    - name: m165437
      url-base: https://github.com/M165437
  projects:
    # urob's fork of zmk
    - name: zmk
      remote: urob
      revision: main
      import: app/west.yml
    # urob's helpers for easier keymap and combo definitons etc.
    - name: zmk-helpers
      remote: urob
      revision: main
    - name: urchin-zmk-module
      remote: duckyb
      revision: main
    - name: nice-view-gem
      remote: m165437
      revision: main
  self:
    path: config
```
